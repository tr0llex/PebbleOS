## src/fw/apps/Kconfig
```kconfig
# SPDX-FileCopyrightText: 2026 Core Devices LLC
# SPDX-License-Identifier: Apache-2.0

menu "Applications"

rsource "demo/Kconfig"
rsource "system/compass/Kconfig"
rsource "system/party/Kconfig"
rsource "watch/Kconfig"

endmenu
```

## src/fw/apps/system/compass/Kconfig
```kconfig
# SPDX-FileCopyrightText: 2026 pebble-app1
# SPDX-License-Identifier: Apache-2.0

config APP_COMPASS
    bool "Compass app"
    default y if MAG || QEMU
    help
      A compass dial driven by the compass data event. On a watch that event
      comes from the e-compass service and needs a magnetometer; under QEMU the
      emulator posts it directly, which is what makes the screen testable.
```

## src/fw/apps/system/party/Kconfig
```kconfig
# SPDX-FileCopyrightText: 2026 pebble-app1
# SPDX-License-Identifier: Apache-2.0

config APP_PARTY
    bool "Party app"
    default y
    help
      A rotating solid cube over a starfield, a strobing screen and a chiptune
      loop on the speaker. Deliberately loud in every sense; it exists to be
      switched on for a minute and switched off again.
```

## src/fw/services/stopwatch/Kconfig
```kconfig
# SPDX-FileCopyrightText: 2026 pebble-app1
# SPDX-License-Identifier: Apache-2.0

config SERVICE_STOPWATCH
    bool "Stopwatch and countdown timer"
    help
      Keeps the stopwatch and the countdown running while the app that shows
      them is closed.

if SERVICE_STOPWATCH

module = SERVICE_STOPWATCH
module-str = Stopwatch
source "subsys/logging/Kconfig.template.log_level"

endif
```

## src/fw/services/wellbeing/Kconfig
```kconfig
# SPDX-FileCopyrightText: 2026 pebble-app1
# SPDX-License-Identifier: Apache-2.0

config SERVICE_WELLBEING
    bool "Wellbeing"
    depends on SERVICE_ACTIVITY
    help
      Night mode for the backlight and the move reminder, both driven by the
      sleep and step data the activity service already collects.

if SERVICE_WELLBEING

module = SERVICE_WELLBEING
module-str = Wellbeing
source "subsys/logging/Kconfig.template.log_level"

endif
```
